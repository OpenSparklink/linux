## drivers/sparklink/Kconfig
```kconfig
# SPDX-License-Identifier: GPL-2.0

menuconfig SPARKLINK_DRIVERS
	bool "SparkLink device drivers"
	depends on SPARKLINK
	help
	  SparkLink controller hardware drivers. Choose the drivers for your
	  SparkLink hardware.

	  If unsure, say N.

if SPARKLINK_DRIVERS

config SPARKLINK_STANDARD_USB
	tristate "Standard SparkLink DLI USB query provider (experimental)"
	depends on USB
	help
	  Bind standard E0/01/05 DLI device/interface descriptors. EP0 commands
	  and interrupt events use the common per-controller Backend lifecycle.
	  Query-only: standard typed policy/data and PM remain unqualified.
	  Firmware/boot-ROM protocols belong to matched vendor drivers.
	  The module is called sparklink_standard_usb. No test device is created.

config SPARKLINK_WS73_USB
	tristate "HiSilicon WS73 USB firmware and BSLE transport (experimental)"
	depends on USB
	select FW_LOADER
	select CRYPTO_LIB_SHA256
	help
	  Bind WS73 USB interfaces (ffff:3733), validate and download the
	  three boot images, and track re-enumeration into runtime mode.
	  Images are loaded from sparklink/ws73/{ws73,wifi_cali,btc_cali}.bin.
	  Runtime mode also requires raw board configuration files:
	  sparklink/ws73/bsle_custom.bin (140 bytes) and pm_config.bin (4 bytes).
	  Wait for BSP_READY, send configuration and open SLE, requiring actual
	  CUSTOMIZE_RECEIVED and BOOT_FINISH replies. This experimental driver
	  queries actual DLI metadata and registers an independent native
	  Runtime in SETUP with bulk/notification URBs. Metadata, native
	  advertising and scanning transactions have real two-device VM
	  evidence. Per-device protocol recovery has bounded retries and
	  diagnostics, but natural-fault/disappearance recovery and the full
	  single/two/four-device matrix remain unqualified. Connection,
	  security, board calibration qualification and USB PM remain open.
	  Do not treat this experimental option as full protocol support.

	  The module is called sparklink_ws73_usb.

config SPARKLINK_VIRTUAL
	tristate "Virtual SparkLink controller (testing)"
	help
	  Explicit test backend, disabled by default. Opening the root-only
	  /dev/sparklink_virtual creates a TEST-bus standard-DLI query Runtime
	  through the common Backend API. Final control-file close retires the
	  exact generation and joins its bounded reply worker. dup shares it.
	  Private test controls allow bounded delayed, dropped or failed replies.
	  No radio, connection, data or physical acceptance is claimed. Production
	  hardware drivers and the daemon do not generate these emulated replies.

	  To compile this as a module, choose M here:
	  the module will be called sparklink_virtual.

	  If unsure, say N.

endif # SPARKLINK_DRIVERS
```

## net/sparklink/Kconfig
```kconfig
# SPDX-License-Identifier: GPL-2.0

menuconfig SPARKLINK
	bool "SparkLink (NearLink) subsystem support"
	depends on RUST
	depends on NET
	select CONFIGFS_FS
	select CRYPTO
	select CRYPTO_AES
	select CRYPTO_CMAC
	select CRYPTO_ECDH
	help
	  SparkLink (also known as NearLink / 星闪) is a short-range wireless
	  communication technology designed for low-latency, low-power, and
	  high-reliability scenarios including smart terminals, smart home,
	  smart vehicles, and industrial IoT.

	  This option enables the SparkLink protocol stack, providing:
	    - SCI (SparkLink Controller Interface) device management
	    - SLE (Synchronous Low Energy) air interface support
	    - Native discovery, physical links and application channels
	    - Limited per-Session security mechanism; full Pair/install still pending

	  Say Y here to compile SparkLink support into the kernel or say M
	  to compile it as a module.

if SPARKLINK

config SPARKLINK_GENL
	bool "SparkLink Generic Netlink interface"
	depends on NET
	help
	  Adds read-only registry count and software version queries to the
	  "sparklink" Generic Netlink family. It does not select a controller,
	  submit commands or publish controller events. Identity-bound Native
	  APIs remain the controller management and observation path.

	  If unsure, say N.

source "drivers/sparklink/Kconfig"

endif # SPARKLINK
```
